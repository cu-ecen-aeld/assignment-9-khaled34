## base_external/package/aesd-char-dev/Config.in
```kconfig
config BR2_PACKAGE_AESD_CHAR_DEV
	bool "aesd-char-dev"
	help
	  Includes aesd character device package
```

## base_external/package/ldd/Config.in
```kconfig
config BR2_PACKAGE_LDD
	bool "ldd"
	help
	  Includes ldd package which will include the scull and misc-modules
```
